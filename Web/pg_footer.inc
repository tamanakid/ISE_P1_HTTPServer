						 </td>
						</tr></tbody></table>
					 </font></center>
					</div>
				 </td>
				</tr>
				<tr>
					<td colspan="5" width="815" valign="top" background="llblue.jpg" style="background-repeat: repeat-y;text-align: center;" class="links">
						<a href="/network.cgi">Network</a>
						<a href="/system.cgi">System</a>
						<a href="/leds.cgi">LED</a>
						<a href="/lcd.cgi">LCD</a>
						<a href="/ad.cgi">AD</a>
					</td>
				</tr>
				<tr>
					<td colSpan=5 height=20 width="805" background="llblue.jpg" style="background-repeat: repeat-y;">
						<p align=center>
							<font face="Verdana" size="1">
								<a href="http://www.keil.com/company/copyright.asp">Copyright</a>
								© 2004-2014
								<a href="http://www.keil.com/company/">KEIL - An ARM Company</a> 
								All rights reserved.
							</font>
						</p>
					</td>
				</tr>
			</tbody>
		</table>
  </div>
	<style>
		td.links a {
			text-align: center;
			margin: 1rem;
			font-size: 1.2rem;
		}
	</style>
</body>
</html>
